## kernel_platform/msm-kernel/arch/arm64/configs/vendor/m269_sec_defconfig
```kconfig
CONFIG_KVM=y
CONFIG_KVM_ARM_HOST=y
CONFIG_KVM_ARM_PMU=y
CONFIG_KVM_ARM_PV_TIME=y
CONFIG_KVM_ARM_VGIC=y
CONFIG_KVM_ARM_VGIC_V3=y
CONFIG_KVM_ARM_VGIC_V3_SYSREGS=y
CONFIG_KVM_ARM_TIMER=y
CONFIG_KVM_MMIO=y
CONFIG_GKI_HIDDEN_VIRTUAL_CONFIGS=y
CONFIG_GKI_HIDDEN_HYPERVISOR_CONFIGS=y
CONFIG_SYS_HYPERVISOR=y
CONFIG_CRYPTO_DEV_VIRTIO=y
CONFIG_VIRTUALIZATION=y
CONFIG_VIRTIO=y
CONFIG_VIRTIO_BLK=y
CONFIG_VIRTIO_NET=y
CONFIG_VIRTIO_CONSOLE=y
CONFIG_VIRTIO_PCI_LIB=y
CONFIG_VIRTIO_MENU=y
CONFIG_VIRTIO_PCI=y
CONFIG_VIRTIO_PCI_LEGACY=y
CONFIG_VIRTIO_BALLOON=y
CONFIG_VIRTIO_INPUT=y
CONFIG_VIRTIO_MMIO=y
CONFIG_VIRTIO_MMIO_CMDLINE_DEVICES=y
CONFIG_VIRTIO_DMA_SHARED_BUFFER=y
CONFIG_VHOST_MENU=y
CONFIG_VHOST=y
CONFIG_VHOST_NET=y
CONFIG_VHOST_VSOCK=y
CONFIG_VHOST_CROSS_ENDIAN_LEGACY=y
CONFIG_ARM64_VHE=y
CONFIG_ARM64_4K_PAGES=y
CONFIG_GUNYAH=y
CONFIG_GUNYAH_PLATFORM=y
CONFIG_GUNYAH_RESOURCE_MANAGER=y
CONFIG_QCOM_SCM=y
CONFIG_ANDROID_VIRTUALIZATION_FRAMEWORK=y
# CONFIG_S2MPU is not set
CONFIG_CMDLINE="stack_depot_disable=on kasan.stacktrace=off kvm-arm.mode=nvhe cgroup_disable=pressure id_aa64mmfr1.vh=1"

#SEC_DEBUG
CONFIG_SOFT_WATCHDOG=m
CONFIG_SEC_KEY_NOTIFIER=m
CONFIG_SEC_CLASS=m
CONFIG_SEC_PARAM=m
CONFIG_SEC_DEBUG=m
CONFIG_SEC_LOG_BUF=m
CONFIG_SEC_REBOOT_CMD=m
CONFIG_SEC_UPLOAD_CAUSE=m
CONFIG_SEC_CRASHKEY=m
CONFIG_SEC_CRASHKEY_LONG=m
CONFIG_SEC_DEBUG_REGION=m
CONFIG_SEC_PMSG=m
CONFIG_SEC_BOOT_STAT=m
CONFIG_SEC_ARM64_AP_CONTEXT=m
CONFIG_SEC_ARM64_FSIMD_DEBUG=m
CONFIG_SEC_ARM64_DEBUG=m
CONFIG_SEC_QC_DEBUG=m
CONFIG_SEC_QC_PARAM=m
CONFIG_SEC_QC_LOGGER=m
CONFIG_SEC_QC_QCOM_WDT_CORE=m
CONFIG_SEC_QC_RBCMD=m
CONFIG_SEC_QC_UPLOAD_CAUSE=m
CONFIG_SEC_QC_DEBUG_PARTITION=m
CONFIG_SEC_QC_SUMMARY=m
CONFIG_SEC_QC_USER_RESET=m
CONFIG_SEC_QC_SMEM=m
CONFIG_SEC_QC_HW_PARAM=m
CONFIG_SEC_QC_RST_EXINFO=m
CONFIG_SEC_QC_RDX_BOOTDEV=m
CONFIG_SEC_QC_SOC_ID=m
CONFIG_SEC_QC_MSM_POWEROFF=m

# UFS
CONFIG_SEC_UFS_FEATURE=y

# SD
CONFIG_SEC_MMC_FEATURE=y

# CP Dynamic reserved memmory
CONFIG_CP_DYNAMIC_MEM_RESERVE=y

# drb, dropdump
CONFIG_SUPPORT_DROPDUMP=m
CONFIG_DEV_RIL_BRIDGE=m

# Network
CONFIG_INET6_AH=y
CONFIG_IP_NF_MATCH_AH=y
CONFIG_IP_NF_MATCH_RPFILTER=y

# USB
CONFIG_USB_CONFIGFS_F_SS_MON_GADGET=m
CONFIG_USB_CONFIGFS_F_CONN_GADGET=m
CONFIG_USB_NOTIFY_LAYER=m
CONFIG_USB_NOTIFY_PROC_LOG=y
CONFIG_USB_HOST_NOTIFY=y
CONFIG_USB_EXTERNAL_NOTIFY=y
CONFIG_USB_NOTIFIER=m
CONFIG_USB_NOTIFY_EXTCON=y

# I/O
CONFIG_MQ_IOSCHED_SSG=m
CONFIG_MQ_IOSCHED_SSG_CGROUP=m
CONFIG_BLK_SEC_STATS=m

#Memory
CONFIG_FAULT_AROUND_BYTES=4096

#VOLD ASEC
CONFIG_CRYPTO_TWOFISH=m
```
